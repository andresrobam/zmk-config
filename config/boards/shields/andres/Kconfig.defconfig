## config/boards/shields/andres/Kconfig.defconfig
```kconfig
if SHIELD_ANDRES_LEFT

config ZMK_KEYBOARD_NAME
    default "andres keeb"
config USB_DEVICE_PRODUCT
    default "andres keeb"
config ZMK_SPLIT_BLE_CENTRAL_BATTERY_LEVEL_FETCHING
    default y
config ZMK_SPLIT_BLE_CENTRAL_BATTERY_LEVEL_PROXY
    default y

config ZMK_SPLIT_ROLE_CENTRAL
    default y

endif

if SHIELD_ANDRES_LEFT || SHIELD_ANDRES_RIGHT

config ZMK_SPLIT
    default y

endif
```

## config/boards/shields/andres/Kconfig.shield
```kconfig
config SHIELD_ANDRES_LEFT
    def_bool $(shields_list_contains,andres_left)
    select ZMK_SPLIT_ROLE_CENTRAL

config SHIELD_ANDRES_RIGHT
    def_bool $(shields_list_contains,andres_right)
```
